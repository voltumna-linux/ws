## conf/layer.conf
```bitbake
# We have a conf and classes directory, add to BBPATH
BBPATH .= ":${LAYERDIR}"

# We have recipes-* directories, add to BBFILES
BBFILES += "${LAYERDIR}/recipes-*/*/*.bb \
	    ${LAYERDIR}/recipes-*/*/*.bbappend"

BBFILE_COLLECTIONS += "ws"
BBFILE_PATTERN_ws = "^${LAYERDIR}/"
BBFILE_PRIORITY_ws = "11"

LAYERSERIES_COMPAT_ws = "kirkstone"

# This should only be incremented on significant changes that will
# cause compatibility issues with other layers
LAYERVERSION_ws = "1"

LAYERDEPENDS_ws = "core"
```
